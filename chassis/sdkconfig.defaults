## chassis_esp32/components/softap_sta/Kconfig
```kconfig
menu "SoftAP STA Configuration"

    menu "SoftAP Configuration"
        comment "SoftAP Configuration"

        config ESP_WIFI_AP_SSID
            string "WiFi AP SSID"
            default "myssid"
            help
                SSID (network name) of the AP for the example to connect to.

        config ESP_WIFI_AP_PASSWORD
            string "WiFi AP Password"
            default "mypassword"
            help
                WiFi password of the AP for the example to use.

        config ESP_WIFI_AP_CHANNEL
            int "WiFi AP Channel"
            range 1 14
            default 1
            help
                WiFi channel (network channel) of the AP for the example to use.

        config ESP_MAX_STA_CONN_AP
            int "Maximal STA connections"
            default 4
            help
                Max number of the STA connects to AP.
    endmenu

    menu "STA Configuration"
        comment "STA Configuration"

        config USE_CAMPUS_NETWORK
            bool "Use the campus network to connect to the Internet"
            default y
            help
                Add functions related to campus network connection and authentication to connect to the Internet.

        config CAMPUS_NETWORK_ID
            string "CAMPUS NETWORK ID"
            depends on USE_CAMPUS_NETWORK
            default "test_id"
            help
                Your campus network user ID.

        config CAMPUS_NETWORK_PASSWORD
            string "CAMPUS NETWORK PASSWORD"
            depends on USE_CAMPUS_NETWORK
            default "test_password"
            help
                Your campus network user password.

        config ESP_WIFI_REMOTE_AP_SSID
            string "WiFi Remote AP SSID"
            default "otherapssid"
            help
                SSID (network name) for the example's sta to connect to.

        config ESP_WIFI_REMOTE_AP_PASSWORD
            string "WiFi Remote AP Password"
            default "otherappassword"
            help
                WiFi password for the example to use.

        config ESP_MAXIMUM_STA_RETRY
            int "Maximum retry"
            default 5
            help
                Set the maximum retry value to prevent the station from continuously
                attempting to reconnect to the Access Point (AP) when the AP doesn't exist.

        choice ESP_WIFI_SCAN_AUTH_MODE_THRESHOLD
            prompt "WiFi Scan auth mode threshold"
            default ESP_WIFI_AUTH_WPA2_PSK
            help
                The weakest authmode to accept in the scan mode.
                This value defaults to ESP_WIFI_AUTH_WPA2_PSK in case password is present
                and ESP_WIFI_AUTH_OPEN is used. Please select ESP_WIFI_AUTH_WEP / ESP_WIFI_AUTH_WPA_PSK
                in case AP is operating in WEP / WPA mode.

            config ESP_WIFI_AUTH_OPEN
                bool "OPEN"
            config ESP_WIFI_AUTH_WEP
                bool "WEP"
            config ESP_WIFI_AUTH_WPA_PSK
                bool "WPA PSK"
            config ESP_WIFI_AUTH_WPA2_PSK
                bool "WPA2 PSK"
            config ESP_WIFI_AUTH_WPA_WPA2_PSK
                bool "WPA/WPA2 PSK"
            config ESP_WIFI_AUTH_WPA3_PSK
                bool "WPA3 PSK"
            config ESP_WIFI_AUTH_WPA2_WPA3_PSK
                bool "WPA2/WPA3 PSK"
            config ESP_WIFI_AUTH_WAPI_PSK
                bool "WAPI PSK"
        endchoice

    endmenu
endmenu
```

## components/campus_network/Kconfig
```kconfig
menu "Campus Network"

    # Create some network option in menuconfig
    config USE_CAMPUS_NETWORK
        bool "Use the campus network to connect to the Internet"
        default y
        help
            Add functions related to campus network connection and authentication to connect to the Internet.

    config CAMPUS_NETWORK_SSID
        string "CAMPUS NETWORK SSID"
        depends on USE_CAMPUS_NETWORK
        default "test_ssid"
        help
            SSID (network name) for the device to connect to.

    config CAMPUS_NETWORK_ID
        string "CAMPUS NETWORK ID"
        depends on USE_CAMPUS_NETWORK
        default "test_id"
        help
            Your campus network user ID.

    config CAMPUS_NETWORK_PASSWORD
        string "CAMPUS NETWORK PASSWORD"
        depends on USE_CAMPUS_NETWORK
        default "test_password"
        help
            Your campus network user password.

endmenu
```

## lidar_esp32/components/ld14/Kconfig
```kconfig
menu "LD14 Configuration"

    orsource "$IDF_PATH/examples/common_components/env_caps/$IDF_TARGET/Kconfig.env_caps"
    
    config LD14_UART_NUM
        int "LD14 UART port number"
        range 0 2
        default 1
        help
            UART port number.

    config LD14_UART_BAUD_RATE
        int "LD14 UART communication speed"
        range 1200 115200
        default 115200
        help
            UART communication speed for the example.

    config LD14_UART_RXD
        int "LD14 UART RXD pin number"
        range ENV_GPIO_RANGE_MIN ENV_GPIO_IN_RANGE_MAX
        default 5
        help
            GPIO number for UART RX pin. See UART documentation for more information
            about available pin numbers for UART.

    config LD14_UART_TXD
        int "LD14 UART TXD pin number"
        range ENV_GPIO_RANGE_MIN ENV_GPIO_OUT_RANGE_MAX
        default 4
        help
            GPIO number for UART TX pin. See UART documentation for more information
            about available pin numbers for UART.

endmenu
```

## lidar_esp32/components/socket_ros2/Kconfig
```kconfig
menu "Socket ROS2 Configuration"
    
    config ROS2_SERVER_HOST_IP_ADDR
        string "ROS2 SERVER HOST IP ADDR"
        default "192.168.0.181"
        help
            ip of the ROS2 Server for the car to connect to.

    config ROS2_SERVER_PORT
            int "ROS2 SERVER PORT"
            default 8899
            help
                port of the ROS2 Server for the car to connect to.

endmenu
```
